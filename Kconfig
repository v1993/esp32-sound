## Kconfig
```kconfig
menu "Sound module configuration"

config SND_MAX_CHANNELS
	int "Maximal count of mixed channels"
	default 64
	range 1 255
	help
		Maximal count of channels to be mixed with SoundMixer.

config SND_USE_IRAM
	bool "Move timer functions to IRAM"
	default y
	help
		This generally allow extra optimisation.
		If you need more space in IRAM, turn it off.

menu "Provider configuration"

config SND_PROVIDER_MAIN_QUEUE_SIZE
	int "Size of main provider queue"
	default 16384
	range 4096 65536
	help
		Length of "data" queue of sound providers. Low values reduce memory usage but may cause lags.

config SND_PROVIDER_CONTROL_QUEUE_SIZE
	int "Size of control provider queue"
	default 16
	range 4 32
	help
		In most cases default value will work fine. Try changing it in case of blocking.

endmenu

endmenu
```
